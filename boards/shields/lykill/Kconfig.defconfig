## boards/shields/lykill/Kconfig.defconfig
```kconfig
if SHIELD_LYKILL_LEFT

# Name must be less than 16 characters long!
#config ZMK_LYKILL
#    default "Lykill"

config ZMK_SPLIT_ROLE_CENTRAL
    default y

endif

if SHIELD_LYKILL_LEFT || SHIELD_LYKILL_RIGHT

config ZMK_SPLIT
    default y

endif
```

## boards/shields/lykill/Kconfig.sheild
```kconfig
config SHIELD_LYKILL_LEFT
    def_bool $(shields_list_contains,lykill_left)

config SHIELD_LYKILL_RIGHT
    def_bool $(shields_list_contains,lykill_right)
    
```
